## drivers/media/platform/s5p-cec/Kconfig
```kconfig
config EXYNOS_HDMI_CEC
        tristate "Samsung HDMI CEC Driver"
        help
          Say Y here if you want support for the HDMI CEC
          interface in S5P Samsung SoC. The driver can be compiled
          as module.
```
